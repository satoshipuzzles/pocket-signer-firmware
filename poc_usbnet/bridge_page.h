// The NIP-46 remote-signer bridge page, served by the device at /bridge.
//
// The device is airgapped; this page runs in the phone/laptop browser and
// lends the device its internet. It speaks NIP-46 ("bunker") on public
// relays and forwards sign requests to the device over the same-origin
// USB-link HTTP API. Every approval still happens on the device screen.
// It also syncs kind-0 profiles (name + avatar) to the device for every
// stored account.
//
// iOS notes baked into this page:
//  * Safari suspends background tabs, killing the relay sockets while the
//    user is in the client tab. "Background mode" loops a silent audio clip
//    which keeps the tab running (the web-radio trick).
//  * navigator.clipboard needs HTTPS; we fall back to execCommand on this
//    plain-HTTP origin.
//  * Supports both connection directions: our bunker:// link, and pasting
//    the client's nostrconnect:// link.
//
// SECURITY MODEL — what each key is and where it lives:
//  * user identity key (nsec): NVS inside the device. NEVER leaves it.
//    The bridge only ever receives finished signatures.
//  * transport key: throwaway secp256k1 key generated by this page, kept in
//    localStorage. It only encrypts the NIP-46 tunnel and signs the kind
//    24133 envelope events. It CANNOT produce user signatures.
#pragma once
#include <Arduino.h>

static const char BRIDGE_PAGE[] PROGMEM = R"BRPG(<!DOCTYPE html>
<html><head><meta charset="utf-8">
<meta name="viewport" content="width=device-width,initial-scale=1">
<title>Signer Bridge</title>
<style>
 body{font-family:-apple-system,system-ui,sans-serif;background:#000;color:#fff;
      margin:0;padding:20px;max-width:640px;margin-inline:auto}
 h1{font-size:22px;margin:0 0 4px}
 .sub{color:#98989f;font-size:14px;margin-bottom:18px;line-height:1.4}
 .card{background:#1c1c1e;border-radius:16px;padding:16px;margin-bottom:14px}
 .lbl{color:#98989f;font-size:12px;text-transform:uppercase;letter-spacing:.08em;margin-bottom:8px}
 .mono{font-family:ui-monospace,Menlo,monospace;font-size:12px;word-break:break-all;line-height:1.5}
 .ok{color:#30d158}.warn{color:#ff9f0a}.err{color:#ff453a}.dim{color:#98989f}
 button{background:#0a84ff;color:#fff;border:0;border-radius:12px;padding:12px 18px;
      font-size:15px;font-weight:600;width:100%;margin-top:10px}
 button.alt{background:#2c2c2e}
 button.on{background:#30d158;color:#04110d}
 input{width:100%;box-sizing:border-box;background:#000;color:#fff;border:1px solid #2c2c2e;
      border-radius:10px;padding:12px;font-family:ui-monospace,Menlo,monospace;font-size:12px}
 #log div{padding:3px 0;border-bottom:1px solid #2c2c2e}
 .dot{display:inline-block;width:9px;height:9px;border-radius:5px;margin-right:7px}
</style></head><body>
<h1>Signer Bridge</h1>
<div class="sub">This tab lends the plugged-in signer your internet connection so
Nostr apps can reach it (NIP-46). Your keys stay in the hardware &mdash; this page
only moves sign <i>requests</i> in and finished <i>signatures</i> out.</div>

<div class="card"><div class="lbl">Status</div>
<div id="dev"><span class="dot" style="background:#98989f"></span><span class="dim">checking device&hellip;</span></div>
<div id="rel" style="margin-top:6px"><span class="dot" style="background:#98989f"></span><span class="dim">connecting to relays&hellip;</span></div>
<div id="who" class="mono dim" style="margin-top:8px"></div>
<button id="ka" class="alt" onclick="toggleKeepAlive()">Enable background mode (do this first)</button></div>

<div class="card"><div class="lbl">Option A &mdash; paste the app's nostrconnect link</div>
<div class="sub" style="margin-bottom:10px">If the app shows a QR / <b>nostrconnect://</b> link
(Jumble, noStrudel...), copy it and paste here:</div>
<input id="nc" placeholder="nostrconnect://...">
<button onclick="connectNostr()">Connect to app</button></div>

<div class="card"><div class="lbl">Option B &mdash; give the app our bunker link</div>
<div class="sub" style="margin-bottom:10px">In the app choose <b>"Login with remote signer"</b>
and paste this:</div>
<div class="mono" id="bunker">&hellip;</div>
<button onclick="copyBunker()">Copy bunker link</button></div>

<div class="card"><div class="lbl">Bitcoin &mdash; sign a PSBT on the device</div>
<div class="sub" style="margin-bottom:10px">Paste the unsigned PSBT (base64) from
<b>nostrtx</b> or any wallet. Review and approve on the device screen; the
signed transaction comes back here ready to broadcast.</div>
<textarea id="psbt" placeholder="cHNidP8B..." style="width:100%;box-sizing:border-box;background:#000;color:#fff;border:1px solid #2c2c30;border-radius:10px;padding:10px;font-family:ui-monospace,Menlo,monospace;font-size:12px;min-height:64px"></textarea>
<button onclick="sendPsbt()">Send to device</button>
<div id="psbt-stat" class="mono dim" style="margin-top:8px"></div>
<div id="psbt-out" class="mono" style="margin-top:6px;word-break:break-all"></div>
<button id="psbt-copy" class="alt" style="display:none" onclick="copySignedTx()">Copy signed tx hex</button></div>

<div class="card"><div class="lbl">Activity</div><div id="log" class="mono"><div class="dim">waiting&hellip;</div></div></div>

<script type="module">
import {generateSecretKey, getPublicKey, finalizeEvent, nip04, nip44, nip19}
  from 'https://esm.sh/nostr-tools@2.10.4';

const RELAYS = ['wss://relay.nsec.app', 'wss://nos.lol', 'wss://offchain.pub'];
const hex = b => Array.from(b).map(x=>x.toString(16).padStart(2,'0')).join('');
const unhex = s => new Uint8Array(s.match(/../g).map(x=>parseInt(x,16)));
const $ = id => document.getElementById(id);
const now = () => Math.floor(Date.now()/1000);

// Single-instance guard: every open bridge tab shares the same transport key,
// so stale tabs would race to answer requests. Newest tab wins; others stand
// down (localStorage 'storage' events only fire in OTHER tabs).
const GEN = String(Date.now()) + Math.random();
localStorage.setItem('bridge_gen', GEN);
let superseded = false;
window.addEventListener('storage', e => {
  if (e.key === 'bridge_gen' && e.newValue !== GEN && !superseded){
    superseded = true;
    try{ Object.values(sockets).forEach(ws=>ws.close()); }catch(_){}
    document.body.innerHTML =
      '<h1>Signer Bridge</h1><div class="sub">A newer bridge tab took over. ' +
      'You can close this one.</div>';
  }
});

function log(msg, cls){
  const d = document.createElement('div');
  if (cls) d.className = cls;
  d.textContent = new Date().toTimeString().slice(0,8) + '  ' + msg;
  const l = $('log');
  l.insertBefore(d, l.firstChild);
  while (l.childNodes.length > 50) l.removeChild(l.lastChild);
}

// --- keep-alive: silent audio loop stops iOS from suspending this tab ------
const SILENT_WAV = 'data:audio/wav;base64,UklGRlIAAABXQVZFZm10IBAAAAABAAEAQB8AAIA+AAACABAAZGF0YS4AAAAAAAAAAAAAAAAAAAAAAAAAAAAAAAAAAAAAAAAAAAAAAAAAAAAAAAAAAAAAAAAA';
const ka_audio = new Audio(SILENT_WAV);
ka_audio.loop = true;
let ka_on = false;
window.toggleKeepAlive = () => {
  if (ka_on){ ka_audio.pause(); ka_on = false;
    $('ka').className = 'alt'; $('ka').textContent = 'Enable background mode (do this first)';
    log('background mode off','warn'); return; }
  ka_audio.play().then(()=>{
    ka_on = true;
    $('ka').className = 'on';
    $('ka').textContent = 'Background mode ON - bridge stays awake';
    log('background mode on - safe to switch tabs','ok');
    if ('mediaSession' in navigator)
      navigator.mediaSession.metadata = new MediaMetadata({title:'Signer Bridge active'});
  }).catch(e=>log('audio blocked: '+e.message,'err'));
};

// --- clipboard that works on plain-HTTP origins ------------------------------
function copyText(t){
  if (navigator.clipboard && window.isSecureContext)
    return navigator.clipboard.writeText(t);
  const ta = document.createElement('textarea');
  ta.value = t;
  ta.style.position = 'fixed';
  document.body.appendChild(ta);
  ta.focus(); ta.select();
  try{ document.execCommand('copy'); }finally{ ta.remove(); }
  return Promise.resolve();
}

// --- transport identity (tunnel-only; NOT the user's key) ------------------
let skHex = localStorage.getItem('bridge_sk');
let secret = localStorage.getItem('bridge_secret');
if (!skHex) {
  skHex = hex(generateSecretKey());
  secret = hex(crypto.getRandomValues(new Uint8Array(8)));
  localStorage.setItem('bridge_sk', skHex);
  localStorage.setItem('bridge_secret', secret);
}
const sk = unhex(skHex);
const transportPub = getPublicKey(sk);

const bunkerUri = 'bunker://' + transportPub + '?' +
  RELAYS.map(r=>'relay='+encodeURIComponent(r)).join('&') + '&secret=' + secret;
$('bunker').textContent = bunkerUri;
window.copyBunker = () => copyText(bunkerUri).then(()=>log('bunker link copied','ok'));

// --- Bitcoin PSBT relay: paste -> device review -> signed hex back --------
let signedTx = '';
window.copySignedTx = () => copyText(signedTx).then(()=>log('signed tx copied','ok'));
window.sendPsbt = async () => {
  const st = $('psbt-stat'), out = $('psbt-out');
  const b64 = $('psbt').value.trim();
  out.textContent = '';
  $('psbt-copy').style.display = 'none';
  if (!b64.startsWith('cHNidP')){ st.textContent = 'that is not a base64 PSBT'; return; }
  try{
    const r = await devFetch('/api/psbt', {method:'POST',
      headers:{'Content-Type':'application/json'},
      body: JSON.stringify({psbt: b64})});
    const j = await r.json();
    if (j.error){ st.textContent = 'device: ' + j.error; return; }
    st.textContent = 'sent — approve or reject ON THE DEVICE SCREEN';
    log('bitcoin tx sent to device for review');
    const poll = setInterval(async () => {
      try{
        const res = await (await devFetch('/api/psbt-result')).json();
        if (res.status === 'pending') return;
        clearInterval(poll);
        if (res.status === 'approved'){
          if (res.psbt){
            // multisig: a partially-signed PSBT comes back, not a final tx
            signedTx = res.psbt;
            st.textContent = 'PARTIAL SIGNATURE added — paste this PSBT into nostrtx (Multisig tab)';
            out.textContent = res.psbt.slice(0, 120) + (res.psbt.length > 120 ? '…' : '');
            $('psbt-copy').textContent = 'Copy signed PSBT';
            log('multisig partial signature added', 'ok');
          } else {
            signedTx = res.hex;
            st.textContent = 'SIGNED on device — broadcast this hex from nostrtx';
            out.textContent = res.hex.slice(0, 120) + (res.hex.length > 120 ? '…' : '');
            log('bitcoin tx signed (' + (res.hex.length/2) + ' bytes)', 'ok');
          }
          $('psbt-copy').style.display = '';
        } else {
          st.textContent = 'DECLINED on device';
          log('bitcoin tx declined', 'err');
        }
      }catch(e){}
    }, 700);
  }catch(e){ st.textContent = 'device unreachable: ' + (e.message || e); }
};
fetch('/api/bridge-info', {method:'POST', headers:{'Content-Type':'application/json'},
  body: JSON.stringify({bunker: bunkerUri})}).catch(()=>{});

// --- device link ------------------------------------------------------------
let devOk = false, userPub = null;
async function pollDevice(){
  try{
    const st = await fetch('/api/status').then(r=>r.json());
    devOk = true;
    $('dev').innerHTML = '<span class="dot" style="background:#30d158"></span>device connected'
      + (st.pending ? ' <span class="warn">(' + st.pending + ' waiting on device)</span>' : '');
    if (!userPub && st.pubkey_set){
      userPub = (await fetch('/api/pubkey').then(r=>r.json())).pubkey;
      $('who').textContent = 'signing as ' + nip19.npubEncode(userPub);
    }
  }catch(e){
    devOk = false;
    $('dev').innerHTML = '<span class="dot" style="background:#ff453a"></span><span class="err">device not reachable</span>';
  }
}
pollDevice(); setInterval(pollDevice, 3000);

// Device fetch with retries: the USB link can blip for a few seconds (e.g.
// right after boot); don't turn that into a failed signature.
async function devFetch(url, opts){
  for (let i = 0; i < 5; i++){
    try{ return await fetch(url, opts); }
    catch(e){
      if (i === 4) throw e;
      await new Promise(r=>setTimeout(r, 1500));
    }
  }
}

// --- encryption helpers (support both NIP-44 and legacy NIP-04 clients) ----
const convKeys = {};
function ck(pub){
  if (!convKeys[pub]) convKeys[pub] = nip44.v2.utils.getConversationKey(sk, pub);
  return convKeys[pub];
}
async function decryptFrom(pub, content){
  if (content.includes('?iv=')) return {plain: await nip04.decrypt(skHex, pub, content), mode:'nip04'};
  return {plain: nip44.v2.decrypt(content, ck(pub)), mode:'nip44'};
}
async function encryptTo(pub, text, mode){
  if (mode === 'nip04') return await nip04.encrypt(skHex, pub, text);
  return nip44.v2.encrypt(text, ck(pub));
}

// --- relays -----------------------------------------------------------------
const sockets = {};          // url -> WebSocket
const seen = new Set();
const okWatch = {};          // event id -> label, to log relay rejections
const k0subs = {};           // sub id -> resolver for kind-0 lookups
const inflight = {};         // sign template -> device request id (dedupe)

function openCount(){ return Object.values(sockets).filter(w=>w.readyState===1).length; }
function relayStatus(){
  const n = openCount(), t = Object.keys(sockets).length;
  $('rel').innerHTML = n > 0
    ? '<span class="dot" style="background:#30d158"></span>' + n + '/' + t + ' relays'
    : '<span class="dot" style="background:#ff453a"></span><span class="err">no relays</span>';
}

function connectRelay(url){
  url = url.trim().replace(/\/+$/,'');  // normalize so we don't open dupes
  if (!/^wss?:\/\//.test(url)) return;
  if (sockets[url] && sockets[url].readyState <= 1) return;
  let ws;
  try { ws = new WebSocket(url); } catch(e){ return; }
  sockets[url] = ws;
  ws.onopen = () => {
    relayStatus();
    ws.send(JSON.stringify(['REQ','nip46',
      {kinds:[24133], '#p':[transportPub], since: now()-5}]));
    log('relay up: ' + url.replace('wss://',''), 'dim');
  };
  ws.onmessage = m => {
    try{
      const msg = JSON.parse(m.data);
      if (msg[0] === 'EVENT'){
        if (msg[1] && String(msg[1]).startsWith('k0') && k0subs[msg[1]])
          k0subs[msg[1]].events.push(msg[2]);
        else if (msg[2]) handleRequest(msg[2]);
      } else if (msg[0] === 'EOSE' && k0subs[msg[1]]){
        k0subs[msg[1]].done();
      } else if (msg[0] === 'OK' && okWatch[msg[1]] && !msg[2]){
        log('relay rejected ' + okWatch[msg[1]] + ': ' + (msg[3]||''), 'err');
      }
    }catch(e){}
  };
  ws.onclose = () => {
    relayStatus();
    if (!superseded) setTimeout(()=>connectRelay(url), 3000);
  };
  ws.onerror = () => { try{ws.close();}catch(e){} };
}
RELAYS.forEach(connectRelay);

// Reconnect instantly when the tab comes back to the foreground.
document.addEventListener('visibilitychange', () => {
  if (!document.hidden){
    log('tab resumed', 'dim');
    Object.keys(sockets).forEach(u => { if (sockets[u].readyState > 1) connectRelay(u); });
    pollDevice();
  }
});

function publish(evt, label){
  okWatch[evt.id] = label || 'event';
  const s = JSON.stringify(['EVENT', evt]);
  let n = 0;
  Object.values(sockets).forEach(ws => { if (ws.readyState === 1){ ws.send(s); n++; } });
  if (n === 0) log('publish failed: no relays', 'err');
}

// --- NIP-46 -------------------------------------------------------------------
async function respond(clientPub, id, result, error, mode){
  const payload = {id};
  if (error) payload.error = error; else payload.result = result;
  const evt = finalizeEvent({
    kind: 24133,
    created_at: now(),
    tags: [['p', clientPub]],
    content: await encryptTo(clientPub, JSON.stringify(payload), mode),
  }, sk);
  publish(evt, 'response');
}

// Client-initiated flow: user pastes the app's nostrconnect:// link.
window.connectNostr = async () => {
  const uri = $('nc').value.trim();
  const m = uri.match(/^nostrconnect:\/\/([0-9a-fA-F]{64})\??(.*)$/);
  if (!m){ log('not a nostrconnect:// link', 'err'); return; }
  const clientPub = m[1].toLowerCase();
  const qp = new URLSearchParams(m[2]);
  const ncSecret = qp.get('secret') || '';
  qp.getAll('relay').forEach(connectRelay);
  setTimeout(async () => {
    // Per NIP-46, the signer confirms by sending result = the link's secret.
    await respond(clientPub, 'nc-' + Math.random().toString(36).slice(2), ncSecret, null, 'nip44');
    log('sent connect confirmation to app', 'ok');
  }, 800);  // give freshly added relays a moment to open
};

async function handleRequest(evt){
  if (superseded) return;
  if (evt.kind !== 24133 || seen.has(evt.id)) return;
  seen.add(evt.id);
  const clientPub = evt.pubkey;
  let req, mode = 'nip44';
  try{
    const d = await decryptFrom(clientPub, evt.content);
    mode = d.mode;
    req = JSON.parse(d.plain);
  }catch(e){ return; }  // not for us / garbage

  const {id, method, params} = req;
  try{
    if (method === 'connect'){
      log('client connected', 'ok');
      // Modern NIP-46: echo the client's secret back (plain "ack" trips
      // session-hijacking warnings in Coracle and friends).
      const echo = (params && params[1] && params[1].length) ? params[1] : 'ack';
      await respond(clientPub, id, echo, null, mode);
    } else if (method === 'switch_relays'){
      // Coracle: "please also listen on my preferred relays."
      let rls = [];
      try{
        const p0 = params && params[0];
        if (typeof p0 === 'string' && p0.trim().startsWith('[')) rls = JSON.parse(p0);
        else rls = (params || []).flat();
      }catch(e){}
      rls = rls.filter(r => typeof r === 'string' && r.startsWith('ws'));
      rls.forEach(connectRelay);
      if (rls.length) log('joined client relays: ' +
        rls.map(r=>r.replace('wss://','')).join(', '), 'dim');
      await respond(clientPub, id, 'ack', null, mode);
    } else if (method === 'get_relays'){
      const obj = {};
      Object.keys(sockets).forEach(u => obj[u] = {read:true, write:true});
      await respond(clientPub, id, JSON.stringify(obj), null, mode);
    } else if (method === 'get_public_key'){
      if (!userPub) userPub = (await devFetch('/api/pubkey').then(r=>r.json())).pubkey;
      await respond(clientPub, id, userPub, null, mode);
    } else if (method === 'ping'){
      await respond(clientPub, id, 'pong', null, mode);
    } else if (method === 'sign_event'){
      const tpl = JSON.parse(params[0]);
      // Reuse the in-flight device request when the client retries the same
      // template (their RPC timeout is shorter than a human decision).
      const fkey = params[0];
      let reqId;
      if (inflight[fkey]){
        reqId = inflight[fkey];
      } else {
        log('sign request: kind ' + tpl.kind + ' -> device', 'warn');
        reqId = (await devFetch('/api/sign', {
          method:'POST', headers:{'Content-Type':'application/json'},
          body: JSON.stringify({
            kind: tpl.kind,
            created_at: tpl.created_at || now(),
            tags: tpl.tags || [],
            content: tpl.content || '',
          })}).then(r=>r.json())).id;
        inflight[fkey] = reqId;
        setTimeout(()=>{ delete inflight[fkey]; }, 200000);
      }
      let res;
      for (let i = 0; i < 720; i++){
        await new Promise(r=>setTimeout(r, 250));
        try{
          res = await fetch('/api/result?id=' + reqId).then(r=>r.json());
        }catch(e){ continue; }  // link blip mid-poll: keep trying
        if (res.status !== 'pending') break;
      }
      if (res && res.status === 'approved'){
        const signed = {
          kind: tpl.kind,
          created_at: res.created_at,
          tags: tpl.tags || [],
          content: tpl.content || '',
          pubkey: res.pubkey,
          id: res.id,
          sig: res.sig,
        };
        log('signed on device (kind ' + tpl.kind + ')', 'ok');
        await respond(clientPub, id, JSON.stringify(signed), null, mode);
      } else {
        log('declined on device', 'err');
        await respond(clientPub, id, null, 'declined on device', mode);
      }
    } else if (method === 'sign_psbt'){
      // NostrTX -> relays -> this bridge -> device USB. The device shows the
      // full transaction review screen; result is final hex (single-sig) or
      // a partially-signed PSBT base64 (multisig).
      const b64 = params && params[0];
      if (!b64 || !b64.startsWith('cHNidP')) throw new Error('not a base64 PSBT');
      const fkey = 'psbt:' + b64.length + ':' + b64.slice(0, 48);
      if (!inflight[fkey]){
        log('bitcoin tx -> device for review', 'warn');
        const j = await devFetch('/api/psbt', {method:'POST',
          headers:{'Content-Type':'application/json'},
          body: JSON.stringify({psbt: b64})}).then(r=>r.json());
        if (j.error) throw new Error(j.error);
        inflight[fkey] = 1;
        setTimeout(()=>{ delete inflight[fkey]; }, 200000);
      }
      let pres;
      for (let i = 0; i < 600; i++){
        await new Promise(r=>setTimeout(r, 300));
        try{ pres = await (await devFetch('/api/psbt-result')).json(); }
        catch(e){ continue; }
        if (pres.status !== 'pending') break;
      }
      if (pres && pres.status === 'approved'){
        log('bitcoin tx signed on device', 'ok');
        await respond(clientPub, id, pres.hex || pres.psbt, null, mode);
      } else {
        log('bitcoin tx declined on device', 'err');
        await respond(clientPub, id, null, 'declined on device', mode);
      }
    } else if (method === 'psbt_result'){
      // Recovery: hand back the last signed transaction still stored on the
      // device (e.g. the phone was backgrounded and missed the live reply).
      const pres = await (await devFetch('/api/psbt-result')).json();
      if (pres.status === 'approved'){
        await respond(clientPub, id, pres.hex || pres.psbt, null, mode);
      } else {
        await respond(clientPub, id, null,
          'no signed transaction on device (status: ' + (pres.status || pres.error || '?') + ')', mode);
      }
    } else {
      await respond(clientPub, id, null, 'method not supported: ' + method, mode);
    }
  }catch(e){
    try{ await respond(clientPub, id, null, String(e.message || e), mode); }catch(_){}
  }
}

// --- kind-0 / kind-3 sync to the device ---------------------------------------
// Generic one-shot fetch: send REQ on all open relays, gather until EOSE.
function fetchEvents(filter, timeout_ms){
  return new Promise(resolve => {
    const subid = 'k0' + Math.random().toString(36).slice(2, 8);
    const sub = {events: [], done: null};
    k0subs[subid] = sub;
    let eoses = 0, sent = 0, finished = false;
    const finish = () => {
      if (finished) return;
      finished = true;
      delete k0subs[subid];
      Object.values(sockets).forEach(ws => {
        if (ws.readyState === 1) ws.send(JSON.stringify(['CLOSE', subid]));
      });
      resolve(sub.events);
    };
    const timer = setTimeout(finish, timeout_ms || 5000);
    sub.done = () => { if (++eoses >= sent){ clearTimeout(timer); finish(); } };
    const req = JSON.stringify(['REQ', subid, filter]);
    Object.values(sockets).forEach(ws => { if (ws.readyState === 1){ ws.send(req); sent++; } });
    if (sent === 0){ clearTimeout(timer); finish(); }
  });
}

async function fetchKind0(pubkey){
  const evs = await fetchEvents({kinds:[0], authors:[pubkey], limit:1});
  let best = null;
  for (const e of evs)
    if (e.kind === 0 && e.pubkey === pubkey && (!best || e.created_at > best.created_at))
      best = e;
  try{ return best ? JSON.parse(best.content) : null; }catch(e){ return null; }
}

async function fetchPictureB64(url){
  // weserv resizes server-side AND serves CORS-open responses, which a
  // plain-HTTP page needs (no extension privileges here). Animated GIF
  // avatars stay animated (n=-1 keeps all frames; device caps at 256KB).
  const isGif = /\.gif(\?|$)/i.test(url);
  const base = 'https://images.weserv.nl/?url=' +
    encodeURIComponent(url.replace(/^https?:\/\//,'')) +
    '&w=96&h=96&fit=cover';
  const grab = async q => {
    const r = await fetch(base + q);
    if (!r.ok) throw new Error('proxy ' + r.status);
    return new Uint8Array(await r.arrayBuffer());
  };
  let buf;
  if (isGif){
    buf = await grab('&output=gif&n=-1');
    if (buf.length > 250 * 1024) buf = await grab('&output=png');  // too fat: still frame
  } else {
    buf = await grab('&output=png');
  }
  let bin = '';
  for (let i = 0; i < buf.length; i += 0x8000)
    bin += String.fromCharCode.apply(null, buf.subarray(i, i + 0x8000));
  return btoa(bin);
}

async function syncProfiles(){
  if (!devOk) return;
  let accounts;
  try{ accounts = (await fetch('/api/accounts').then(r=>r.json())).accounts; }
  catch(e){ return; }
  for (const a of accounts){
    const meta = await fetchKind0(a.pubkey);
    if (!meta) continue;
    const name = (meta.display_name || meta.name || '').trim();
    const about = (meta.about || '').trim().slice(0, 140);
    const lud16 = (meta.lud16 || meta.lud06 || '').trim().slice(0, 64);
    let picture_b64 = null;
    if (meta.picture && !a.has_picture){
      try{ picture_b64 = await fetchPictureB64(meta.picture); }
      catch(e){ log('avatar fetch failed: ' + e.message, 'warn'); }
    }
    if (!name && !about && !lud16 && !picture_b64) continue;
    await fetch('/api/profile', {method:'POST',
      headers:{'Content-Type':'application/json'},
      body: JSON.stringify({pubkey: a.pubkey, name, about, lud16, picture_b64})});
    log('profile -> device: ' + (name || a.pubkey.slice(0,8)) +
        (picture_b64 ? ' (with picture)' : ''), 'ok');
  }
}

// Follow list of the ACTIVE account: kind-3 -> batched kind-0s -> device.
// Names/lightning addresses travel in /api/follows; avatars go one by one
// through /api/profile (picture-only, so the device's NVS isn't flooded).
let followsSyncing = false;
async function syncFollows(){
  if (!devOk || followsSyncing) return;
  followsSyncing = true;
  try{
    let accounts;
    try{ accounts = (await fetch('/api/accounts').then(r=>r.json())).accounts; }
    catch(e){ return; }
    const active = accounts.find(a => a.active);
    if (!active) return;

    // One query for every account's kind-3; prefer the active account's list,
    // otherwise fall back to any account that has one (new keys follow nobody).
    const k3s = await fetchEvents(
      {kinds:[3], authors: accounts.map(a => a.pubkey), limit: 20}, 6000);
    const newest = {};
    for (const e of k3s)
      if (e.kind === 3 && (!newest[e.pubkey] || e.created_at > newest[e.pubkey].created_at))
        newest[e.pubkey] = e;
    let best = newest[active.pubkey], owner = active.pubkey;
    if (!best){
      for (const a of accounts)
        if (newest[a.pubkey]){ best = newest[a.pubkey]; owner = a.pubkey; break; }
    }
    if (!best){ log('no account has published a follow list yet', 'dim'); return; }
    if (owner !== active.pubkey)
      log('active key follows nobody - showing follows of ' +
          (accounts.find(a=>a.pubkey===owner).name || owner.slice(0,8)), 'dim');

    const pks = [...new Set(best.tags
      .filter(t => t[0] === 'p' && /^[0-9a-f]{64}$/.test(t[1] || ''))
      .map(t => t[1]))].slice(0, 48);
    if (!pks.length) return;

    const evs = await fetchEvents({kinds:[0], authors: pks, limit: 150}, 8000);
    const metaEvt = {};
    for (const e of evs){
      if (e.kind !== 0 || !pks.includes(e.pubkey)) continue;
      if (!metaEvt[e.pubkey] || e.created_at > metaEvt[e.pubkey].created_at)
        metaEvt[e.pubkey] = e;
    }
    const follows = pks.map(pk => {
      let m = {};
      try{ m = metaEvt[pk] ? JSON.parse(metaEvt[pk].content) : {}; }catch(e){}
      return {pk,
        name: (m.display_name || m.name || '').trim().slice(0, 24),
        lud16: (m.lud16 || m.lud06 || '').trim().slice(0, 64),
        picture: (m.picture || '').slice(0, 200)};
    });

    // picture URLs ride along so avatars can be (re)pushed on later visits
    // without refetching kind-0s.
    await devFetch('/api/follows', {method:'POST',
      headers:{'Content-Type':'application/json'},
      body: JSON.stringify({pubkey: active.pubkey, follows})});
    log('follows -> device: ' + follows.length, 'ok');

    await pushFollowAvatars(follows);
  } finally {
    followsSyncing = false;
  }
}

async function pushFollowAvatars(follows){
  let pushed = 0;
  for (const f of follows){
    if (pushed >= 32) break;
    if (!f.picture) continue;
    let has = false;
    try{
      const r = await fetch('/api/profile?pubkey=' + f.pk);
      has = r.ok && (await r.json()).has_picture;
    }catch(e){}
    if (has) continue;
    try{
      const b64 = await fetchPictureB64(f.picture);
      await fetch('/api/profile', {method:'POST',
        headers:{'Content-Type':'application/json'},
        body: JSON.stringify({pubkey: f.pk, name:'', about:'', lud16:'',
                              picture_b64: b64})});
      pushed++;
      log('avatar -> device: ' + (f.name || f.pk.slice(0,8)), 'dim');
    }catch(e){}
  }
  if (pushed) log('follow avatars -> device: ' + pushed, 'ok');
}

// Fill in any avatars the device is missing for its CURRENT follows list
// (covers reloads where the kind-3 fetch fails or nothing changed).
async function syncMissingAvatars(){
  if (!devOk || followsSyncing) return;
  try{
    const r = await fetch('/api/follows');
    if (!r.ok) return;
    const j = await r.json();
    if (j.follows && j.follows.length) await pushFollowAvatars(j.follows);
  }catch(e){}
}

setTimeout(syncProfiles, 4000);       // once relays are up
setInterval(syncProfiles, 120000);    // and refresh occasionally
setTimeout(syncFollows, 9000);        // after profiles have landed
setInterval(syncFollows, 300000);
setTimeout(syncMissingAvatars, 45000);  // catch stragglers
</script></body></html>)BRPG";
